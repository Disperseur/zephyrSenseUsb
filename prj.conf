## prj.conf
```kconfig
# USB
CONFIG_USB_DEVICE_STACK=y
CONFIG_USB_DEVICE_PID=0x0004
CONFIG_USB_DEVICE_INITIALIZE_AT_BOOT=n
CONFIG_SERIAL=y
CONFIG_CONSOLE=y
CONFIG_UART_CONSOLE=y
CONFIG_UART_LINE_CTRL=y

# # Peripherals
CONFIG_GPIO=y
CONFIG_I2C=y

# # Sensors
CONFIG_SENSOR=y
CONFIG_BMI270=y

# # debug
# CONFIG_LOG=y
# CONFIG_SENSOR_LOG_LEVEL_DBG=y
# CONFIG_I2C_LOG_LEVEL_DBG=y

# added to ease communication with the computer api
CONFIG_BOOT_BANNER=n
```

## src/main.c
```c
#include <zephyr/kernel.h>
#include <zephyr/usb/usb_device.h>
#include <zephyr/sys/printk.h>
#include "global.h"
#include "node_led.h"
#include "node_cmd.h"
#include "node_measures.h"

board_t board = {
    .led = {
        .led_red   					= GPIO_DT_SPEC_GET(LED_RED, gpios),
        .led_green 					= GPIO_DT_SPEC_GET(LED_GREEN, gpios),
        .led_blue  					= GPIO_DT_SPEC_GET(LED_BLUE, gpios)
    },
    .sensors = {
        .devices = {
            .sensor_pressure     	= DEVICE_DT_GET_ONE(st_lps22hb_press),
            .sensor_temperature  	= DEVICE_DT_GET_ONE(renesas_hs300x),
            .sensor_acceleration 	= DEVICE_DT_GET_ONE(bosch_bmi270)
        },
        .period                     = 500,
        .ringbuffer_index           = 0
    },
    .console 						= DEVICE_DT_GET(DT_CHOSEN(zephyr_console)),
	
    .status  						= STOPPED,
	.mode							= STREAMING,
	.sensor_type					= ALL,

    .trigger1 = {
        .trigger_en                 = false,
        .triggered_sensor           = TEMPERATURE,
        .comp                       = SUP,
        .floor                      = 0
    }
};

int main(void)
{
    node_led_init();

    
    if (usb_enable(NULL)) {
        printk("Failed to start USB\n");
        while(1);
    }

    // uint32_t dtr = 0;
    // while (!dtr) {
    //     uart_line_ctrl_get(board.console, UART_LINE_CTRL_DTR, &dtr);
    //     k_sleep(K_MSEC(100));
    // }

    node_cmd_init();

    // printk("STARTING\n");
    while (!device_is_ready(board.sensors.devices.sensor_pressure)) {
        board.status = FAULT;
        printk("Device %s is not ready\n", board.sensors.devices.sensor_pressure->name);
        k_sleep(K_SECONDS(1));
    }
    while (!device_is_ready(board.sensors.devices.sensor_temperature)) {
        printk("Device %s is not ready\n", board.sensors.devices.sensor_temperature->name);
        k_sleep(K_SECONDS(1));
    }
    while (!device_is_ready(board.sensors.devices.sensor_acceleration)) {
        printk("Device %s is not ready\n", board.sensors.devices.sensor_acceleration->name);
        k_sleep(K_SECONDS(1));
    }
    // printk("STARTED\n");

    setup_sensor_acceleration(board.sensors.devices.sensor_acceleration);

    node_measures_init();

    while (1) {
        k_sleep(K_FOREVER);
    }
}
```

## src/global.h
```c
#ifndef GLOBAL_H
#define GLOBAL_H

#include <zephyr/kernel.h>
#include <zephyr/drivers/gpio.h>
#include <zephyr/drivers/sensor.h>
#include <zephyr/drivers/uart.h>

#define LED_RED    DT_ALIAS(led0)
#define LED_GREEN  DT_ALIAS(led1)
#define LED_BLUE   DT_ALIAS(led2)
#define COMMAND_BUFFER_SIZE 100
#define RINGBUFFER_SIZE 100

#define THREAD_CMD_PRIO 5
#define THREAD_MEASURES_PRIO 1

typedef enum {  SUP,
                INF} _trigger_comp_t;

typedef enum {  RUNNING,
                STOPPED,
                FAULT} _board_status_t;

typedef enum {  STREAMING,
                ONESHOT,
                RINGBUFFER} _board_mode_t;

typedef enum {  NONE,
                TEMPERATURE,
                PRESSURE,
                HUMIDITY,
                ALTITUDE,
                ACCELERATION,
                GYROSCOPE,
                MAGFIELD, 
                ALL,
                ENV,
                MOTION
              } _sensor_type_t;


typedef struct _accel_t {
    int64_t ax, ay, az;
} accel_t;

typedef struct _gyro_t {
    int64_t gx, gy, gz;
} gyro_t;

typedef struct _data_t {
    uint32_t timestamp;
    int64_t temperature, humidity, pressure, altitude;
    accel_t accel;
    gyro_t  gyro;
} data_t;

typedef struct _rgbled_t {
    struct gpio_dt_spec led_red, led_green, led_blue;
} rgbled_t;

typedef struct _devices_t {
    const struct device *sensor_pressure;
    const struct device *sensor_temperature;
    const struct device *sensor_acceleration;
} devices_t;

typedef struct _sensors_t {
    data_t data;
    data_t ringbuffer[RINGBUFFER_SIZE];

    devices_t devices;

    unsigned int period;
    unsigned int ringbuffer_index;
} sensors_t;

typedef struct _trigger_t {
    bool trigger_en;
    _sensor_type_t triggered_sensor;
    _trigger_comp_t comp;
    int floor;
} trigger_t;


typedef struct _board_t {
    rgbled_t led;
    sensors_t sensors;
    const struct device *console;
    char command_buffer[COMMAND_BUFFER_SIZE];
    
    _board_status_t status;
    _board_mode_t mode;
    _sensor_type_t sensor_type;

    // trigger section
    trigger_t trigger1;

} board_t;

extern board_t board;

#endif
```

## src/node_cmd.c
```c
#include <zephyr/kernel.h>
#include <zephyr/drivers/uart.h>
#include "global.h"
#include "node_cmd.h"
#include "node_measures.h"
#include "string.h"

K_THREAD_STACK_DEFINE(cmd_thread_stack_area, 1024);
struct k_thread cmd_thread_data;
struct k_sem sem_cmd;

void node_cmd_init(void) {
    k_sem_init(&sem_cmd, 0, 1);
    k_thread_create(&cmd_thread_data, cmd_thread_stack_area, K_THREAD_STACK_SIZEOF(cmd_thread_stack_area),
                    _handler_cmd, NULL, NULL, NULL, THREAD_CMD_PRIO, 0, K_NO_WAIT);

    uart_irq_callback_set(board.console, _cb_uart_rx);
    uart_irq_rx_enable(board.console);
}

void _handler_cmd(void*, void*, void*) {
    while(1) {
        k_sem_take(&sem_cmd, K_FOREVER);

        /*traitement de la commande*/
        printk("ACK\n");

        if(strncmp(board.command_buffer, "HELP", 4) == 0) {
            printk("List of available commands in this shell :\n");
            printk("\n");
            printk("GET STATUS\n");
            printk("GET MODE\n");
            printk("GET SENSORS\n");
            printk("GET SPEED\n");
            printk("GET RINGBUFFER\n");
            printk("GET TRIGGER1\n");
            printk("\n");
            printk("START\n");
            printk("STOP\n");
            printk("\n");
            printk("SET MODE \t<ONESHOT|STREAMING|RINGBUFFER>\n");
            printk("SET SENSORS \t<TEMPERATURE|HUMIDITY|PRESSURE|ALTITUDE|ACCELERATION|GYROSCOPE|ALL|ENV|MOTION>\n");
            printk("SET SPEED \t<int period in ms between each measure>\n");
            printk("SET TRIGGER1 \t<ON|OFF>\n");
            printk("SET TRIGGER1 \tSENSOR <TEMPERATURE|PRESSURE|HUMIDITY|ALTITUDE>\n");
            printk("SET TRIGGER1 \tCOMP <SUP|INF>\n");
            printk("SET TRIGGER1 \tFLOOR <int value in unit*1000 used by the trigger to compare>\n");
            printk("\n");
        }

        if(strncmp(board.command_buffer, "GET STATUS", 10) == 0) {
            printk("STATUS ");

            switch (board.status)
            {
            case RUNNING:
                printk("RUNNING\n");
                break;

            case STOPPED:
                printk("STOPPED\n");
                break;

            case FAULT:
                printk("FAULT\n");
                break;
            
            default:
                printk("UNKNOWN\n");
                break;
            }

        }
        else if(strncmp(board.command_buffer, "GET MODE", 8) == 0) {
            printk("MODE ");

            switch (board.mode)
            {
            case STREAMING:
                printk("STREAMING\n");
                break;

            case ONESHOT:
                printk("ONESHOT\n");
                break;

            case RINGBUFFER:
                printk("RINGBUFFER\n");
                break;
            
            default:
                break;
            }

        }
        else if(strncmp(board.command_buffer, "GET SENSORS", 11) == 0) {
            printk("SENSORS ");

            switch (board.sensor_type)
            {
            case NONE:
                printk("NONE\n");
                break;

            case TEMPERATURE:
                printk("TEMPERATURE\n");
                break;
            
            case PRESSURE:
                printk("PRESSURE\n");
                break;

            case HUMIDITY:
                printk("HUMIDITY\n");
                break;

            case ALTITUDE:
                printk("ALTITUDE\n");
                break;

            case ACCELERATION:
                printk("ACCELERATION\n");
                break;

            case GYROSCOPE:
                printk("NOGYROSCOPENE\n");
                break;

            case MAGFIELD:
                printk("MAGFIELD\n");
                break;

            case ALL:
                printk("ALL\n");
                break;

            case ENV:
                printk("ENV\n");
                break;

            case MOTION:
                printk("MOTION\n");
                break;
            
            default:
                printk("UNKNOWN\n");
                break;
            }
        }
        else if(strncmp(board.command_buffer, "GET SPEED", 9) == 0) {
            printk("SPEED %d\n", board.sensors.period);
        }
        else if(strncmp(board.command_buffer, "GET RINGBUFFER", 14) == 0) {
            // afficher la taille pour le decodage
            printk("RINGBUFFER %d\n", RINGBUFFER_SIZE);

            // afficher ringbuffer
            for(int i = 0; i<RINGBUFFER_SIZE; i++) {
                printk("%d %d TEMPERATURE %lld\n",         i, board.sensors.ringbuffer[i].timestamp, board.sensors.ringbuffer[i].temperature);
                printk("%d %d HUMIDITY %lld\n",            i, board.sensors.ringbuffer[i].timestamp, board.sensors.ringbuffer[i].humidity);
                printk("%d %d PRESSURE %lld\n",            i, board.sensors.ringbuffer[i].timestamp, board.sensors.ringbuffer[i].pressure);
                printk("%d %d ALTITUDE %lld\n",            i, board.sensors.ringbuffer[i].timestamp, board.sensors.ringbuffer[i].altitude);
                printk("%d %d ACCEL_LIN %lld %lld %lld\n", i, board.sensors.ringbuffer[i].timestamp, board.sensors.ringbuffer[i].accel.ax, board.sensors.ringbuffer[i].accel.ay, board.sensors.ringbuffer[i].accel.az);
                printk("%d %d ACCEL_ROT %lld %lld %lld\n", i, board.sensors.ringbuffer[i].timestamp, board.sensors.ringbuffer[i].gyro.gx, board.sensors.ringbuffer[i].gyro.gy, board.sensors.ringbuffer[i].gyro.gz);
                // printk("\n");
            }
        }
        else if(strncmp(board.command_buffer, "GET TRIGGER1", 12) == 0) {
            printk("TRIGGER1 ");
            if(board.trigger1.trigger_en) printk("ON\n");
            else printk("OFF\n");

            printk("TRIGGER1 SENSOR ");
            switch (board.trigger1.triggered_sensor)
            {
            case TEMPERATURE:
                printk("TEMPERATURE\n");
                break;

            case PRESSURE:
                printk("PRESSURE\n");
                break;

            case HUMIDITY:
                printk("HUMIDITY\n");
                break;

            case ALTITUDE:
                printk("ALTITUDE\n");
                break;

            case NONE:
                printk("NONE\n");
                break;
            
            default:
                printk("UNKNOWN\n");
                break;
            }

            printk("TRIGGER1 COMP ");
            switch (board.trigger1.comp)
            {
            case SUP:
                printk("SUP\n");
                break;
            
            case INF:
                printk("INF\n");
                break;
            
            default:
                printk("UNKNOWN\n");
                break;
            }

            printk("TRIGGER1 FLOOR %d\n", board.trigger1.floor);
        }
        else if(strncmp(board.command_buffer, "START", 5) == 0) {
            if(board.status == STOPPED) {
                    if(board.mode == STREAMING || board.mode == RINGBUFFER) {
                        k_timer_start(&timer_measures, K_MSEC(board.sensors.period), K_MSEC(board.sensors.period)); // demarre le timer qui give le semaphore periodiquement
                        board.status = RUNNING;
                    }
                    else if(board.mode == ONESHOT) {
                        k_sem_give(&sem_measures); // give directement le semaphore pour faire une mesure
                    }
                printk("DONE\n");
            }
        }
        else if(strncmp(board.command_buffer, "STOP", 4) == 0) {
            if(board.status == RUNNING) {
                k_timer_stop(&timer_measures);
                //k_sem_give(&sem_measures); //pour avoir un "DONE" dans tout les cas
                board.status = STOPPED;

                printk("DONE\n");
            }
        }
        else if(strncmp(board.command_buffer, "SET", 3) == 0 && board.status == STOPPED) {
            if(strstr(board.command_buffer, "MODE") != NULL) {
                if(strstr(board.command_buffer, "STREAMING") != NULL) {
                    board.mode = STREAMING;
                    printk("DONE\n");
                }
                if(strstr(board.command_buffer, "ONESHOT") != NULL) {
                    board.mode = ONESHOT;
                    printk("DONE\n");
                }
                if(strstr(board.command_buffer, "RINGBUFFER") != NULL) {
                    board.mode = RINGBUFFER;
                    printk("DONE\n");
                }
            }

            if(strstr(board.command_buffer, "SENSORS") != NULL) {
                if(strstr(board.command_buffer, "NONE") != NULL) {
                    board.sensor_type = NONE;
                    printk("DONE\n");
                }
                if(strstr(board.command_buffer, "TEMPERATURE") != NULL) {
                    board.sensor_type = TEMPERATURE;
                    printk("DONE\n");
                }
                if(strstr(board.command_buffer, "PRESSURE") != NULL) {
                    board.sensor_type = PRESSURE;
                    printk("DONE\n");
                }
                if(strstr(board.command_buffer, "HUMIDITY") != NULL) {
                    board.sensor_type = HUMIDITY;
                    printk("DONE\n");
                }
                if(strstr(board.command_buffer, "ALTITUDE") != NULL) {
                    board.sensor_type = ALTITUDE;
                    printk("DONE\n");
                }
                if(strstr(board.command_buffer, "ACCELERATION") != NULL) {
                    board.sensor_type = ACCELERATION;
                    printk("DONE\n");
                }
                if(strstr(board.command_buffer, "GYROSCOPE") != NULL) {
                    board.sensor_type = GYROSCOPE;
                    printk("DONE\n");
                }
                if(strstr(board.command_buffer, "ALL") != NULL) {
                    board.sensor_type = ALL;
                    printk("DONE\n");
                }
                if(strstr(board.command_buffer, "ENV") != NULL) {
                    board.sensor_type = ENV;
                    printk("DONE\n");
                }
                if(strstr(board.command_buffer, "MOTION") != NULL) {
                    board.sensor_type = MOTION;
                    printk("DONE\n");
                }
            }

            if(strstr(board.command_buffer, "SPEED") != NULL) {
                int period = atoi(board.command_buffer+10);
                if(0 <= period && period <= 10000) {
                    board.sensors.period = period;
                    printk("DONE\n");
                }
            }

            if(strstr(board.command_buffer, "TRIGGER1") != NULL) {
                if(strstr(board.command_buffer, "ON") != NULL) {
                    board.trigger1.trigger_en = true;
                    printk("DONE\n");
                }
                if(strstr(board.command_buffer, "OFF") != NULL) {
                    board.trigger1.trigger_en = false;
                    printk("DONE\n");
                }

                if(strstr(board.command_buffer, "SENSOR") != NULL) {
                    if(strstr(board.command_buffer, "TEMPERATURE") != NULL) {
                        board.trigger1.triggered_sensor = TEMPERATURE;
                        printk("DONE\n");
                    }
                    if(strstr(board.command_buffer, "PRESSURE") != NULL) {
                        board.trigger1.triggered_sensor = PRESSURE;
                        printk("DONE\n");
                    }
                    if(strstr(board.command_buffer, "HUMIDITY") != NULL) {
                        board.trigger1.triggered_sensor = HUMIDITY;
                        printk("DONE\n");
                    }
                    if(strstr(board.command_buffer, "ALTITUDE") != NULL) {
                        board.trigger1.triggered_sensor = ALTITUDE;
                        printk("DONE\n");
                    }
                }

                if(strstr(board.command_buffer, "COMP SUP") != NULL) {
                    board.trigger1.comp = SUP;
                    printk("DONE\n");
                }

                if(strstr(board.command_buffer, "COMP INF") != NULL) {
                    board.trigger1.comp = INF;
                    printk("DONE\n");
                }
                
                // traitement de la limite dans une commande separee
                if(strstr(board.command_buffer, "FLOOR") != NULL) {
                    int floor = atoi(board.command_buffer+19);
                    if(floor != 0) {
                        board.trigger1.floor = floor;
                        printk("DONE\n");
                    }
                }
            }
        }

        // command buffer erase
        for(int i = 0; i<COMMAND_BUFFER_SIZE; i++) {
            board.command_buffer[i] = 0;
        }
    }
}

void _cb_uart_rx(const struct device *console, void *user_data) {
    if(uart_irq_rx_ready(console)) {
        int i = 0;
        while(uart_fifo_read(console, &board.command_buffer[i], 1)) {
            i++;
        }
    }
    k_sem_give(&sem_cmd);
}
```

## src/node_cmd.h
```c
#ifndef NODE_CMD_H
#define NODE_CMD_H

#include "global.h"

extern struct k_thread cmd_thread_data;
extern struct k_sem sem_cmd;

void node_cmd_init(void);
void _handler_cmd(void*, void*, void*);
void _cb_uart_rx(const struct device *console, void *user_data);

#endif
```

## src/node_led.c
```c
#include <zephyr/kernel.h>
#include <zephyr/drivers/gpio.h>
#include "global.h"
#include "node_led.h"

struct k_timer timer_led;

void node_led_init(void) {
    while (!(gpio_is_ready_dt(&board.led.led_red) &&
             gpio_is_ready_dt(&board.led.led_green) &&
             gpio_is_ready_dt(&board.led.led_blue))) {
        k_sleep(K_MSEC(100));
    }
    gpio_pin_configure_dt(&board.led.led_red, GPIO_OUTPUT_INACTIVE);
    gpio_pin_configure_dt(&board.led.led_green, GPIO_OUTPUT_INACTIVE);
    gpio_pin_configure_dt(&board.led.led_blue, GPIO_OUTPUT_INACTIVE);

    k_timer_init(&timer_led, _cb_timer_status_led, NULL);
    k_timer_start(&timer_led, K_MSEC(300), K_MSEC(300));
}

void _cb_timer_status_led(struct k_timer *tim) {
    switch (board.status) {
    case RUNNING:
        gpio_pin_set_dt(&board.led.led_red, 0);
        gpio_pin_set_dt(&board.led.led_blue, 0);
        gpio_pin_toggle_dt(&board.led.led_green);
        break;
    case STOPPED:
        gpio_pin_set_dt(&board.led.led_red, 0);
        gpio_pin_set_dt(&board.led.led_blue, 0);
        gpio_pin_set_dt(&board.led.led_green, 1);
        break;
    case FAULT:
        gpio_pin_set_dt(&board.led.led_green, 0);
        gpio_pin_set_dt(&board.led.led_blue, 0);
        gpio_pin_toggle_dt(&board.led.led_red);
        break;
    default:
        gpio_pin_set_dt(&board.led.led_red, 0);
        gpio_pin_set_dt(&board.led.led_green, 0);
        gpio_pin_set_dt(&board.led.led_blue, 1);
        break;
    }
}
```

## src/node_led.h
```c
#ifndef NODE_LED_H
#define NODE_LED_H

#include "global.h"

extern struct k_timer timer_led;

void node_led_init(void);
void _cb_timer_status_led(struct k_timer *tim);

#endif
```

## src/node_measures.c
```c
#include <zephyr/kernel.h>
#include <zephyr/drivers/sensor.h>
#include <math.h>
#include "global.h"
#include "node_measures.h"

K_THREAD_STACK_DEFINE(measures_thread_stack_area, 2048);
struct k_thread measures_thread_data;
struct k_sem sem_measures;
struct k_timer timer_measures;

void node_measures_init(void) {
    k_sem_init(&sem_measures, 0, 100);
    k_thread_create(&measures_thread_data, measures_thread_stack_area, K_THREAD_STACK_SIZEOF(measures_thread_stack_area),
                    _handler_measures, NULL, NULL, NULL, THREAD_MEASURES_PRIO, 0, K_NO_WAIT);

    k_timer_init(&timer_measures, _cb_timer_measures, NULL);
}

void _handler_measures(void*, void*, void*) {
    int ret;
    struct sensor_value val_pressure, val_temperature, val_humidity;
    struct sensor_value acc[3], gyr[3];
    unsigned int nb_measures_todo = 0;

    while (1) {
        k_sem_take(&sem_measures, K_FOREVER);

        // check si trop rapide
        nb_measures_todo = k_sem_count_get(&sem_measures);
        if(nb_measures_todo > 0) {
            printk("BACKLOG %d\n", nb_measures_todo); // peut etre a afficher systematiquement pour simplifier la gestion cote API
        }

        ret = sensor_sample_fetch(board.sensors.devices.sensor_pressure);
        if(ret != 0) printk("failed to fetch pressure sensor: %d\n", ret);
        else {
            ret = sensor_channel_get(board.sensors.devices.sensor_pressure, SENSOR_CHAN_PRESS, &val_pressure);
            if(ret != 0) printk("failed to get pressure: %d\n", ret);
        }

        ret = sensor_sample_fetch(board.sensors.devices.sensor_temperature);
        if(ret != 0) printk("failed to fetch temperature sensor: %d\n", ret);
        else {
            ret = sensor_channel_get(board.sensors.devices.sensor_temperature, SENSOR_CHAN_AMBIENT_TEMP, &val_temperature);
            if(ret != 0) printk("failed to get temperature: %d\n", ret);
            ret = sensor_channel_get(board.sensors.devices.sensor_temperature, SENSOR_CHAN_HUMIDITY, &val_humidity);
            if(ret != 0) printk("failed to get humidity: %d\n", ret);
        }

        ret = sensor_sample_fetch(board.sensors.devices.sensor_acceleration);
        if(ret != 0) printk("failed to fetch acceleration sensor: %d\n", ret);
        else {
            ret = sensor_channel_get(board.sensors.devices.sensor_acceleration, SENSOR_CHAN_ACCEL_XYZ, acc);
            if(ret != 0) printk("failed to get acc: %d\n", ret);
            ret = sensor_channel_get(board.sensors.devices.sensor_acceleration, SENSOR_CHAN_GYRO_XYZ, gyr);
            if(ret != 0) printk("failed to get gyr: %d\n", ret);
        }

        board.sensors.data.timestamp    = k_uptime_get_32();

        board.sensors.data.temperature  = sensor_value_to_milli(&val_temperature);
        board.sensors.data.humidity     = sensor_value_to_milli(&val_humidity);
        board.sensors.data.pressure     = sensor_value_to_milli(&val_pressure);
        board.sensors.data.altitude     = 1000.0 * 44330.0 * ( 1.0 - pow(sensor_value_to_double(&val_pressure)/101.325, 1/5.255) );
        board.sensors.data.accel.ax     = sensor_value_to_milli(&acc[0]);
        board.sensors.data.accel.ay     = sensor_value_to_milli(&acc[1]);
        board.sensors.data.accel.az     = sensor_value_to_milli(&acc[2]);
        board.sensors.data.gyro.gx      = sensor_value_to_milli(&gyr[0]);
        board.sensors.data.gyro.gy      = sensor_value_to_milli(&gyr[1]);
        board.sensors.data.gyro.gz      = sensor_value_to_milli(&gyr[2]);

        if(board.mode == ONESHOT || board.mode == STREAMING) {
            int64_t *value;

            if(board.trigger1.trigger_en) {
                // cas trigger allume
                switch (board.trigger1.triggered_sensor)
                {
                case TEMPERATURE:
                    value = &board.sensors.data.temperature;
                    break;

                case PRESSURE:
                    value = &board.sensors.data.pressure;
                    break;

                case HUMIDITY:
                    value = &board.sensors.data.humidity;
                    break;

                case ALTITUDE:
                    value = &board.sensors.data.altitude;
                    break;
                
                default:
                    value = &board.sensors.data.temperature;
                    break;
                }


                if( ((*value > board.trigger1.floor) && (board.trigger1.comp == SUP)) ||
                    ((*value < board.trigger1.floor) && (board.trigger1.comp == INF))
                ) {
                    if(board.sensor_type == TEMPERATURE     || board.sensor_type == ENV     || board.sensor_type == ALL)    printk("%d TEMPERATURE %lld\n",         board.sensors.data.timestamp, board.sensors.data.temperature);
                    if(board.sensor_type == HUMIDITY        || board.sensor_type == ENV     || board.sensor_type == ALL)    printk("%d HUMIDITY %lld\n",            board.sensors.data.timestamp, board.sensors.data.humidity);
                    if(board.sensor_type == PRESSURE        || board.sensor_type == ENV     || board.sensor_type == ALL)    printk("%d PRESSURE %lld\n",            board.sensors.data.timestamp, board.sensors.data.pressure);
                    if(board.sensor_type == ALTITUDE        || board.sensor_type == ALL)                                    printk("%d ALTITUDE %lld\n",            board.sensors.data.timestamp, board.sensors.data.altitude);
                    if(board.sensor_type == ACCELERATION    || board.sensor_type == MOTION  || board.sensor_type == ALL)    printk("%d ACCEL_LIN %lld %lld %lld\n", board.sensors.data.timestamp, board.sensors.data.accel.ax, board.sensors.data.accel.ay, board.sensors.data.accel.az);
                    if(board.sensor_type == GYROSCOPE       || board.sensor_type == MOTION  || board.sensor_type == ALL)    printk("%d ACCEL_ROT %lld %lld %lld\n", board.sensors.data.timestamp, board.sensors.data.gyro.gx,  board.sensors.data.gyro.gy,  board.sensors.data.gyro.gz);        
                    // printk("\n");
                }
            }
            else {
                // pas de trigger
                if(board.sensor_type == TEMPERATURE     || board.sensor_type == ENV     || board.sensor_type == ALL)    printk("%d TEMPERATURE %lld\n",         board.sensors.data.timestamp, board.sensors.data.temperature);
                if(board.sensor_type == HUMIDITY        || board.sensor_type == ENV     || board.sensor_type == ALL)    printk("%d HUMIDITY %lld\n",            board.sensors.data.timestamp, board.sensors.data.humidity);
                if(board.sensor_type == PRESSURE        || board.sensor_type == ENV     || board.sensor_type == ALL)    printk("%d PRESSURE %lld\n",            board.sensors.data.timestamp, board.sensors.data.pressure);
                if(board.sensor_type == ALTITUDE        || board.sensor_type == ALL)                                    printk("%d ALTITUDE %lld\n",            board.sensors.data.timestamp, board.sensors.data.altitude);
                if(board.sensor_type == ACCELERATION    || board.sensor_type == MOTION  || board.sensor_type == ALL)    printk("%d ACCEL_LIN %lld %lld %lld\n", board.sensors.data.timestamp, board.sensors.data.accel.ax, board.sensors.data.accel.ay, board.sensors.data.accel.az);
                if(board.sensor_type == GYROSCOPE       || board.sensor_type == MOTION  || board.sensor_type == ALL)    printk("%d ACCEL_ROT %lld %lld %lld\n", board.sensors.data.timestamp, board.sensors.data.gyro.gx,  board.sensors.data.gyro.gy,  board.sensors.data.gyro.gz);        
                // printk("\n");
            }
        }
        else if(board.mode == RINGBUFFER) {
            // mecanisme de trigger pas implemente pour le ringbuffer encore
            board.sensors.ringbuffer[board.sensors.ringbuffer_index%RINGBUFFER_SIZE] = board.sensors.data; // possible source de problemes de pointeurs
            board.sensors.ringbuffer_index++;
        }
    }
}

void _cb_timer_measures(struct k_timer *tim) {
    k_sem_give(&sem_measures);
}

void setup_sensor_acceleration(const struct device *sensor_acceleration) {
    struct sensor_value full_scale, sampling_freq, oversampling;

    full_scale.val1 = 2; full_scale.val2 = 0;
    sampling_freq.val1 = 100; sampling_freq.val2 = 0;
    oversampling.val1 = 1; oversampling.val2 = 0;

    sensor_attr_set(sensor_acceleration, SENSOR_CHAN_ACCEL_XYZ, SENSOR_ATTR_FULL_SCALE, &full_scale);
    sensor_attr_set(sensor_acceleration, SENSOR_CHAN_ACCEL_XYZ, SENSOR_ATTR_OVERSAMPLING, &oversampling);
    sensor_attr_set(sensor_acceleration, SENSOR_CHAN_ACCEL_XYZ, SENSOR_ATTR_SAMPLING_FREQUENCY, &sampling_freq);

    full_scale.val1 = 500; full_scale.val2 = 0;
    sampling_freq.val1 = 100; sampling_freq.val2 = 0;
    oversampling.val1 = 1; oversampling.val2 = 0;

    sensor_attr_set(sensor_acceleration, SENSOR_CHAN_GYRO_XYZ, SENSOR_ATTR_FULL_SCALE, &full_scale);
    sensor_attr_set(sensor_acceleration, SENSOR_CHAN_GYRO_XYZ, SENSOR_ATTR_OVERSAMPLING, &oversampling);
    sensor_attr_set(sensor_acceleration, SENSOR_CHAN_GYRO_XYZ, SENSOR_ATTR_SAMPLING_FREQUENCY, &sampling_freq);
}
```

## src/node_measures.h
```c
#ifndef NODE_MEASURES_H
#define NODE_MEASURES_H

#include "global.h"

extern struct k_thread measures_thread_data;
extern struct k_sem sem_measures;
extern struct k_timer timer_measures;

void node_measures_init(void);
void _handler_measures(void*, void*, void*);
void _cb_timer_measures(struct k_timer *tim);
void setup_sensor_acceleration(const struct device *sensor_acceleration);

#endif
```
